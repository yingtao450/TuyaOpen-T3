## t3_os/armino/middleware/driver/h264/Kconfig
```kconfig
menu "H264_CONFIG"
	config H264
		bool "Enable h264"
		default n

	config H264_QUALITY_LEVEL
		int "set h264 compress quality level"
		range 0 3
		default 2

	config H264_GOP_START_IDR_FRAME
		bool "Enable add pps and sps before i frame"
		default y
endmenu
```

## t3_os/armino/middleware/driver/jpeg_dec/Kconfig
```kconfig
menu "JPEG_DEC"
	config JPEGDEC_HW
		bool "Enable JPEGDEC Display"
		default n
		
	config JPEGDEC_HW_SUPPORT_DRI
		bool "Enable JPEGDEC support dri"
		default n
endmenu
```

## t3_os/armino/middleware/driver/psram/Kconfig
```kconfig
menu "PSRAM"
	config PSRAM
		bool "Enable PSRAM"
		default n

	#TODO identify psram factory type
		choice USB_PSRAM
			prompt "Select PSRAM chip id"
			default PSRAM_APS6408L_O

			config PSRAM_APS6408L_O
				bool "PSRAM_APS6408L_O"
				help
					use aps6408l_o 8MByte

			config PSRAM_W955D8MKY_5J
				bool "PSRAM_W955D8MKY_5J"
				help
					use W955D8MKY_5J 4MByte

			config PSRAM_APS128XXO_OB9
				bool "PSRAM_APS128XXO_OB9"
				help
					use APS128XXO_OB9 16Mbyte
		endchoice

	config PSRAM_AS_SYS_MEMORY
		depends on PSRAM
		bool "Enable psram_malloc API"
		default n

	config USE_PSRAM_HEAP_AT_SRAM_OOM
		depends on PSRAM_AS_SYS_MEMORY
		bool "Use psram_malloc at os_malloc failed."
		default n

	config PSRAM_HEAP_BASE
		depends on PSRAM_AS_SYS_MEMORY
		hex "Set psram_malloc base address"
		default 0x60700000 if PSRAM_APS6408L_O
		default 0x60320000 if PSRAM_W955D8MKY_5J
		default 0x60B00000 if PSRAM_APS128XXO_OB9
		help
			The psram address is from 0x60000000 to 0x60800000 in BK7256 for psram aps6408l_o
			The suggested option is 0x60600000 or 0x60700000
			The psram address is from 0x60000000 to 0x60400000 in BK7256 for psram w955d8mky-5j
			The suggested option is 0x60300000
			The psram address is from 0x60000000 to 0x61000000 in BK7258 for psram APS128XXO-OB9
			The suggested option is 0x60B00000

	config PSRAM_HEAP_CPU0_BASE_ADDER
		depends on PSRAM
		hex "Set psram_malloc base address"
		default 0x60700000 if PSRAM_APS6408L_O
		default 0x60320000 if PSRAM_W955D8MKY_5J
		default 0x60B00000 if PSRAM_APS128XXO_OB9

	config PSRAM_HEAP_SIZE
		depends on PSRAM_AS_SYS_MEMORY
		hex "Set psram heap size"
		default 0x80000 if PSRAM_APS6408L_O
		default 0xE0000 if PSRAM_W955D8MKY_5J
		default 0x500000 if PSRAM_APS128XXO_OB9
		help
			psram aps6408l-o
			0x100000 - 1M
			The max size is 0x800000 in BK7256
			The suggested option is 0x100000 or 0x200000
			psram w955d8mky-5j
			0xE0000 - 896KB
			The max size is 0x400000 in BK7256
			The suggested option is 0xE0000
			psram apsx256
			0x500000 - 5M
			The max size is 0x1000000 in BK7258
			The suggested option is 0x5000000 or 0x1000000

	config PSRAM_WRITE_THROUGH
		depends on PSRAM
		bool "Enable PSRAM write through"
		default n

	config PSRAM_CALIBRATE
		depends on PSRAM
		bool "Enable PSRAM calibrate"
		default n
endmenu
```

## tuyaos/tuyaos_adapter/Kconfig
```kconfig
menu "TUYA_SDK"
    config TUYA_OS_ADAPTER
        bool "Add tuya os adapter"
        default n

    config TUYA_APP_SOURCES
        bool "Add tuya app"
        default n

    config TUYA_COMPONENTS
        bool "Add tuya component"
        default n

    config APP_CLI_STATION
        depends on TUYA_OS_ADAPTER
        bool "Add tuya app cli station component"
        default n

    config APP_DEMO_QUICKSTAT
        depends on TUYA_OS_ADAPTER
        bool "Add tuya app demo quickstart component"
        default n

    config configUSE_RECURSIVE_MUTEXES
        bool "configUSE_RECURSIVE_MUTEXES"
        default y

endmenu
```
